## app/boards/cebt_board/board.yml
```yaml
board:
  name: cebt_board
  full_name: Cebt Board
  vendor: cebt
  socs:
  - name: mcxa156
```

## app/boards/cebt_my_board/Kconfig.cebt_my_board
```kconfig
config BOARD_CEBT_MY_BOARD
	select SOC_MCXA156 if BOARD_CEBT_MY_BOARD
	select SOC_PART_NUMBER_MCXA156VLL
```

## app/boards/cebt_my_board/board.yml
```yaml
board:
  name: cebt_my_board
  full_name: CEBT My Board
  vendor: CEBT
  socs:
  - name: mcxa156
```

## app/drivers/our_driver/Kconfig
```kconfig
#File with the software´s configuration

config OUR_DRIVER
    bool "Enable our driver"
    default y
    help
      Enable our custom driver.
```
